## board/microsys/mpxs32g274a/Kconfig
```kconfig
# Copyright (C) 2022 MicroSys Electronics GmbH

config SYS_VENDOR
	string
	default "microsys"

config MICROSYS_MPXS32G274A
	bool "Support mpxs32g274a"
	imply CMD_PMIC
	imply DM_PMIC
	imply DM_PMIC_VR5510
	imply NXP_S32CC_BOARD_COMMON
	imply CMD_EEPROM
	imply I2C_EEPROM
	imply ADC
	imply PHY
	imply PHYLIB
	imply PHY_GIGE
	imply DM_USB
	imply SAF1508BET_USB_PHY
	imply USB
	imply USB_EHCI_HCD
	imply USB_ULPI
	select NXP_S32G2
	select SARADC_S32CC
	select SPI_FLASH_STMICRO
	select USB_EHCI_MX6
	help
		Platforms with MicroSys' MPXS32G274A module

menu "MicroSys"

choice
    prompt "Carrier Board CRX for S32G"
    default MICROSYS_CRXS32G2

config MICROSYS_CRXS32G2
	bool "CRX-S32G Carrier Board Rev. 2"
	imply NVME
	imply RGMII
	imply PHY_MARVELL
	select ADC

config MICROSYS_CRXS32G3
	bool "CRX-S32G Carrier Board Rev. 3"
	imply NVME
	imply RGMII
	imply PHY_MARVELL
	select ADC

endchoice

endmenu
```

## board/microsys/s32g274asbc3/Kconfig
```kconfig
# Copyright (C) 2022 MicroSys Electronics GmbH

if TARGET_S32G274ASBC3

config SYS_VENDOR
    string
    default "microsys"

config SYS_CONFIG_NAME
    string
    default "s32g274asbc3"

config SYS_BOARD
    string
    default "s32g274asbc3"

endif

config S32GEN1_HWCONFIG
    string "S32GEN1 HWConfig definition"
    default "pcie0:mode=rc,clock=ext;pcie1:mode=sgmii,clock=ext,fmhz=125,xpcs_mode=0" if (PCIE_S32GEN1 && FSL_PFENG)
    default ""
    help
      The configuration for the PCIe controllers, stored in
      the variable 'hwconfig'
      It configures the mode (RC, EP, SGMII) or the clock type
      (internal or external)
```

## configs/MPXT1042_4GB_SDCARD_defconfig
```kconfig
CONFIG_SPL=y
CONFIG_SYS_EXTRA_OPTIONS="PPC_T1042,RAMBOOT_PBL,SPL_FSL_PBL,SDCARD,MPXT1042,SYS_FSL_DDR4,DDR_4GB"
# CONFIG_CMD_IMLS is not set
# CONFIG_CMD_FLASH is not set
CONFIG_PPC=y
CONFIG_MPC85xx=y
CONFIG_TARGET_MPXT1040=y
CONFIG_FIT=y
CONFIG_FIT_VERBOSE=y
CONFIG_OF_BOARD_SETUP=y
CONFIG_OF_STDOUT_VIA_ALIAS=y
CONFIG_BOOTDELAY=10
CONFIG_HUSH_PARSER=y
CONFIG_OF_LIBFDT=y
```
